## arch/arm64/configs/aosp_defconfig
```kconfig
#
#
# AOSP defconfig
#
CONFIG_SYSVIPC=y
CONFIG_SYSVIPC_SYSCTL=y
CONFIG_SYSVIPC_COMPAT=y
CONFIG_TASKSTATS=y
CONFIG_TASK_XACCT=y
CONFIG_TASK_IO_ACCOUNTING=y
CONFIG_IPC_NS=y
CONFIG_SLABINFO=y
CONFIG_MODVERSIONS=y
CONFIG_MMAP_READAROUND_LIMIT=32
CONFIG_BALANCE_ANON_FILE_RECLAIM=y
CONFIG_IP_NF_TARGET_REJECT_SKERR=y
CONFIG_DDK_VERSION_OS="n"
CONFIG_MALI_R15P0=y
# CONFIG_MALI_R22P0 is not set
# CONFIG_MALI_R28P0 is not set
# CONFIG_MALI_MIDGARD_DVFS is not set
# CONFIG_MALI_CORESTACK is not set
# CONFIG_MALI_GPU_MMU_AARCH64 is not set
# CONFIG_USB_ANDROID_SAMSUNG_MTP is not set
CONFIG_SEC_OOM_KILLER=y
# CONFIG_ARM_ARCH_TIMER_VCT_ACCESS=y
```
